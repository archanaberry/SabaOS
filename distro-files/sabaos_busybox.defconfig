## distro-files/sabaos_busybox.defconfig
```kconfig
# ============================================================================
# SABAOS BUSYBOX MINIMAL DEFCONFIG (v1.36.x)
# 
# Filosofi: POSIX personality layer untuk Fishix kernel
# Bukan Linux-centric toolbox
# 
# Target:
#  - Portable across Unix-like kernels
#  - Kernel-agnostic (Fishix compatible)
#  - POSIX-first, Linux-compatible sebagai bonus
#  - ~1.5-2.5 MB static binary
# ============================================================================

#
# Build Options
#
CONFIG_STATIC=y
CONFIG_PIE=y
CONFIG_STATIC_LIBGCC=y
CONFIG_FEATURE_LIBBUSYBOX_STATIC=y

#
# Busybox Settings
#
CONFIG_BUSYBOX_DEFAULT_UNZIP=y
CONFIG_DEBUG_PESSIMIZE=y
CONFIG_WERROR=n

#
# General Configuration
#
CONFIG_DESKTOP=y
CONFIG_FEATURE_SHADOWPASSWDS=y
CONFIG_FEATURE_INSTALL_LONG_OPTIONS=y
CONFIG_INCLUDE_SUSv2=y
CONFIG_FEATURE_VERBOSE=y
CONFIG_FEATURE_EDITING=y
CONFIG_FEATURE_EDITING_MAX_LEN=4096
CONFIG_FEATURE_EDITING_VI=y
CONFIG_FEATURE_EDITING_HISTORY=256
CONFIG_LOCALE_SUPPORT=y
CONFIG_UNICODE_SUPPORT=y
CONFIG_UNICODE_BIDI_SUPPORT=y
CONFIG_UNICODE_NEUTRAL_TABLE=y
CONFIG_UNICODE_COMBINING_WIPES_PRECEDING_CHARS=y

#
# ============================================================================
# ✅ POSIX CORE (Always ON - mutu-required)
# ============================================================================
#

# Archival Utilities (Portable)
CONFIG_AR=y
CONFIG_BZIP2=y
CONFIG_CPIO=y
CONFIG_DPKG=y
CONFIG_DPKG_DEB=y
CONFIG_GZIP=y
CONFIG_GZIP_FAST=y
CONFIG_GUNZIP=y
CONFIG_GZEXE=y
CONFIG_TAR=y
CONFIG_TAR_CREATE=y
CONFIG_TAR_GZIP=y
CONFIG_TAR_BZIP2=y
CONFIG_TAR_XZ=y
CONFIG_TAR_LZMA=y
CONFIG_UNZIP=y
CONFIG_UNCOMPRESS=y
CONFIG_UNLZMA=y
CONFIG_UNXZ=y

# Coreutils
CONFIG_BASENAME=y
CONFIG_CAT=y
CONFIG_CHGRP=y
CONFIG_CHMOD=y
CONFIG_CHOWN=y
CONFIG_CHROOT=y
CONFIG_CMP=y
CONFIG_CP=y
CONFIG_CUT=y
CONFIG_DATE=y
CONFIG_DD=y
CONFIG_DIRNAME=y
CONFIG_DOS2UNIX=y
CONFIG_UNIX2DOS=y
CONFIG_DU=y
CONFIG_ECHO=y
CONFIG_ENV=y
CONFIG_EXPAND=y
CONFIG_EXPR=y
CONFIG_FALSE=y
CONFIG_FOLD=y
CONFIG_HEAD=y
CONFIG_INSTALL=y
CONFIG_LN=y
CONFIG_LS=y
CONFIG_LS_TIMESTAMPS=y
CONFIG_LS_FILEMARKS=y
CONFIG_LS_FOLLOWLINKS=y
CONFIG_LS_RECURSIVE=y
CONFIG_LS_SORTFILES=y
CONFIG_LS_COLOR=y
CONFIG_LS_COLOR_IS_DEFAULT=y
CONFIG_MKDIR=y
CONFIG_MKFIFO=y
CONFIG_MKNOD=y
CONFIG_MKTEMP=y
CONFIG_MV=y
CONFIG_NICE=y
CONFIG_NL=y
CONFIG_OD=y
CONFIG_PASTE=y
CONFIG_PRINTENV=y
CONFIG_PRINTF=y
CONFIG_REALPATH=y
CONFIG_RM=y
CONFIG_RMDIR=y
CONFIG_SEQ=y
CONFIG_SHUF=y
CONFIG_SLEEP=y
CONFIG_SORT=y
CONFIG_STAT=y
CONFIG_STTY=y
CONFIG_SUM=y
CONFIG_SYNC=y
CONFIG_TAC=y
CONFIG_TAIL=y
CONFIG_TEE=y
CONFIG_TEST=y
CONFIG_TOUCH=y
CONFIG_TR=y
CONFIG_TRUE=y
CONFIG_TTY=y
CONFIG_UNAME=y
CONFIG_UNEXPAND=y
CONFIG_UNIQ=y
CONFIG_USLEEP=y
CONFIG_UUENCODE=y
CONFIG_UUDECODE=y
CONFIG_WANTDUP=y
CONFIG_WC=y
CONFIG_WHO=y
CONFIG_WHOAMI=y
CONFIG_YES=y

# Find Utilities
CONFIG_FIND=y
CONFIG_FIND_XDEV=y
CONFIG_FIND_MAXDEPTH=y
CONFIG_FIND_NEWER=y
CONFIG_FIND_INUM=y
CONFIG_FIND_EXEC=y
CONFIG_FIND_PRUNE=y
CONFIG_FIND_DELETE=y
CONFIG_FIND_PAREN=y
CONFIG_FIND_SIZE=y
CONFIG_FIND_REGEX=y
CONFIG_FIND_CONTEXT=n
CONFIG_XARGS=y

# Pattern Matching
CONFIG_GREP=y
CONFIG_EGREP=y
CONFIG_FGREP=y
CONFIG_SED=y

# Text Utilities
CONFIG_AWK=y
CONFIG_FEATURE_AWK_LONG_REGEXES=y
CONFIG_CMP=y
CONFIG_DIFF=y
CONFIG_ED=y
CONFIG_PATCH=y

#
# ============================================================================
# ✅ PROCESS MANAGEMENT (Safe for Fishix - if /proc available)
# ============================================================================
#

CONFIG_KILL=y
CONFIG_KILLALL=y
CONFIG_KILLALL5=y
CONFIG_PGREP=y
CONFIG_PIDOF=y
CONFIG_PKILL=y
CONFIG_PSTREE=y
CONFIG_PS=y
CONFIG_FEATURE_PS_LONG=y
CONFIG_FEATURE_PS_TIME=y
CONFIG_FEATURE_PS_UNUSUAL_SYSTEMS=y
CONFIG_FEATURE_PS_ADDITIONAL_COLUMNS=y
CONFIG_TOP=y
CONFIG_FEATURE_TOP_CPU_PERCENT_HIST=y
CONFIG_FEATURE_TOP_DECIMALS=y
CONFIG_FEATURE_TOP_SMP_CPU=y
CONFIG_FEATURE_TOP_BATCH_MODE=y
CONFIG_UPTIME=y
CONFIG_FREE=y
CONFIG_FUSER=y

#
# ============================================================================
# ✅ NETWORKING (POSIX-compatible, Fishix safe)
# ============================================================================
#

CONFIG_HOSTNAME=y
CONFIG_DNSDOMAINNAME=y
CONFIG_PING=y
CONFIG_PING6=y
CONFIG_FEATURE_FANCY_PING=y
CONFIG_TRACEROUTE=y
CONFIG_TRACEROUTE6=y
CONFIG_FEATURE_TRACEROUTE_VERBOSE=y
CONFIG_FEATURE_TRACEROUTE_SOURCE_ROUTE=y
CONFIG_FEATURE_TRACEROUTE_USE_ICMP=y
CONFIG_TELNET=y
CONFIG_TELNET_AUTOLOGIN=y
CONFIG_WGET=y
CONFIG_FEATURE_WGET_STATUSBAR=y
CONFIG_FEATURE_WGET_AUTHENTICATION=y
CONFIG_FEATURE_WGET_LONG_OPTIONS=y
CONFIG_FEATURE_WGET_TIMEOUT=y
CONFIG_FEATURE_WGET_SSL_HELPER=n
CONFIG_FEATURE_WGET_SSL=n
CONFIG_HTTP_DIGEST_AUTH=n
CONFIG_NETSTAT=y
CONFIG_FEATURE_NETSTAT_WIDE=y
CONFIG_FEATURE_NETSTAT_PRG=y
CONFIG_FEATURE_NETSTAT_SYMBOLIC=y
CONFIG_IFCONFIG=y
CONFIG_FEATURE_IFCONFIG_IP=y
CONFIG_FEATURE_IFCONFIG_BROADCAST=y
CONFIG_FEATURE_IFCONFIG_HW=y
CONFIG_FEATURE_IFCONFIG_MEMSTART_IOADDR_IRQ=y
CONFIG_FEATURE_IFCONFIG_SET_MAC_ADDRESS=y
CONFIG_FEATURE_IFCONFIG_SLIP=y
CONFIG_FEATURE_IFCONFIG_HW_SLIP=n
CONFIG_FEATURE_IFCONFIG_HW_CSLIP=n
CONFIG_FEATURE_IFCONFIG_HW_PPP=n
CONFIG_FEATURE_IFCONFIG_HW_CYBERCABLE=n
CONFIG_FEATURE_IFCONFIG_HW_TUNNEL=n
CONFIG_ROUTE=y
CONFIG_ARP=y
CONFIG_ARPING=y
CONFIG_IPCALC=y
CONFIG_FEATURE_IPCALC_FANCY=y
CONFIG_FEATURE_IPCALC_LONG_OPTIONS=y
CONFIG_IP=y
CONFIG_FEATURE_IP_ADDRESS=y
CONFIG_FEATURE_IP_LINK=y
CONFIG_FEATURE_IP_ROUTE=y
CONFIG_FEATURE_IP_TUNNEL=y
CONFIG_FEATURE_IP_RULE=y
CONFIG_NC=y
CONFIG_NC_EXTRA=y
CONFIG_NC_110_COMPAT=y
CONFIG_NSLOOKUP=y

#
# ============================================================================
# ❌ LINUX-SPECIFIC (DISABLE - Fishix may not have these)
# ============================================================================
#

# Console Utilities (Linux-only)
CONFIG_CHVT=n
CONFIG_CLEAR=n
CONFIG_DEALLOCVT=n
CONFIG_DUMPKMAP=n
CONFIG_KBD_MODE_RAW=n
CONFIG_RESET=n
CONFIG_SETCONSOLE=n
CONFIG_SETFONT=n
CONFIG_SETKEYCODES=n
CONFIG_SETLOGCONS=n
CONFIG_SETVESABLANK=n
CONFIG_LOADFONT=n
CONFIG_LOADKMAP=n

# Kernel Utilities (Linux-specific syscalls)
CONFIG_BLOCKDEV=n
CONFIG_FLOCK=n
CONFIG_GETOPT=n
CONFIG_HEXDUMP=n
CONFIG_HWCLOCK=n
CONFIG_I2CGET=n
CONFIG_I2CSET=n
CONFIG_I2CDUMP=n
CONFIG_I2CDETECT=n
CONFIG_IONICE=n
CONFIG_INOTIFYD=n
CONFIG_IOCTL_HEX2STR_ERROR=n
CONFIG_LSMOD=n
CONFIG_MODINFO=n
CONFIG_INSMOD=n
CONFIG_RMMOD=n
CONFIG_MODPROBE=n
CONFIG_MODPROBE_SMALL=n
CONFIG_DEPMOD=n
CONFIG_LSUSB=n
CONFIG_LSPCI=n
CONFIG_MDEVD=n
CONFIG_MDEV=n
CONFIG_FEATURE_MDEV_CONF=n
CONFIG_FEATURE_MDEV_RENAME=n
CONFIG_FEATURE_MDEV_RENAME_REGEXP=n
CONFIG_FEATURE_MDEV_EXEC=n
CONFIG_FEATURE_MDEV_LOAD_FIRMWARE=n
CONFIG_MICROCOM=n
CONFIG_MKSWAP=n
CONFIG_MORE=n
CONFIG_PIVOT_ROOT=n
CONFIG_READLINK=n
CONFIG_RENICE=n
CONFIG_RTCWAKE=n
CONFIG_SETARCH=n
CONFIG_SWAPON=n
CONFIG_SWAPOFF=n
CONFIG_SYSCTL=n
CONFIG_SYSLOG=n
CONFIG_FEATURE_SYSLOGD=n
CONFIG_FEATURE_SYSLOGD_READ_BUFFER_SIZE=n
CONFIG_FEATURE_SYSLOGD_DUP=n
CONFIG_FEATURE_SYSLOGD_CFG=n
CONFIG_FEATURE_SYSLOGD_READ_BUFFER_SIZE=n
CONFIG_FEATURE_SYSLOG_INFO=n
CONFIG_FEATURE_IPC_SYSLOG=n
CONFIG_FEATURE_IPC_SYSLOG_BUFFER_SIZE=n

# Login/User utilities (Linux-specific)
CONFIG_ADDUSER=n
CONFIG_FEATURE_ADDUSER_LONG_OPTIONS=n
CONFIG_FEATURE_ADDUSER_CRYPT=n
CONFIG_DELUSER=n
CONFIG_ADDGROUP=n
CONFIG_FEATURE_ADDGROUP_LONG_OPTIONS=n
CONFIG_DELGROUP=n
CONFIG_GETTY=n
CONFIG_LOGIN=n
CONFIG_LOGIN_SESSION_AS_CHILD=n
CONFIG_LOGIN_SCRIPTS=n
CONFIG_SU=n
CONFIG_FEATURE_SU_SYSLOG=n
CONFIG_FEATURE_SU_CHECKS_SHELLS=n
CONFIG_SULOGIN=n
CONFIG_FEATURE_UTMP=n
CONFIG_FEATURE_WTMP=n

# Security (Linux-specific)
CONFIG_SELINUX=n
CONFIG_FEATURE_HAVE_RPC=n
CONFIG_FEATURE_NFS_READ_ONLY=n
CONFIG_FEATURE_NFS_READ_WRITE=n

# Filesystem (Linux ioctl heavy)
CONFIG_MOUNT=n
CONFIG_UMOUNT=n
CONFIG_FINDFS=n
CONFIG_MKFS_EXT2=n
CONFIG_MKFS_MINIX=n
CONFIG_FSCK_MINIX=n
CONFIG_MKFS_REISERFS=n
CONFIG_FSCK_REISERFS=n
CONFIG_MKFS_VFAT=n
CONFIG_FSCK_FAT=n
CONFIG_FSTRIM=n
CONFIG_E2FSCK=n
CONFIG_BADBLOCKS=n

#
# ============================================================================
# ✅ SHELL (ash ONLY - POSIX-first)
# ============================================================================
#

CONFIG_ASH=y
CONFIG_ASH_BASH_COMPAT=n
CONFIG_ASH_IDLE_TIMEOUT=n
CONFIG_ASH_JOB_CONTROL=y
CONFIG_ASH_ALIAS=y
CONFIG_ASH_GETOPTS=y
CONFIG_ASH_BUILTIN_ECHO=y
CONFIG_ASH_BUILTIN_PRINTF=y
CONFIG_ASH_BUILTIN_TEST=y
CONFIG_ASH_EXPAND_KNOWNVARS=y
CONFIG_ASH_EXPAND_MAX_SUBSCRIPTS=y
CONFIG_ASH_MATH_SUPPORT=y
CONFIG_ASH_MATH_SUPPORT_64=y
CONFIG_ASH_RANDOM_SUPPORT=y
CONFIG_ASH_READONLY=y
CONFIG_ASH_OPTIMIZE_FOR_SIZE=y
CONFIG_FEATURE_SH_IS_ASH=y
CONFIG_FEATURE_BASH_IS_ASH=n

# Disable other shells
CONFIG_HUSH=n
CONFIG_HUSH_BASH_COMPAT=n

#
# ============================================================================
# ✅ INIT SYSTEM (BusyBox init - Critical for SabaOS)
# ============================================================================
#

CONFIG_INIT=y
CONFIG_FEATURE_INIT_SYSLOG=y
CONFIG_FEATURE_INIT_COREDUMPS=n
CONFIG_FEATURE_INIT_D=y
CONFIG_FEATURE_USE_INITTAB=y
CONFIG_FEATURE_INITRD=y

#
# ============================================================================
# ✅ RUNTIME (Essentials for bootable system)
# ============================================================================
#

# Essential
CONFIG_HALT=y
CONFIG_POWEROFF=y
CONFIG_REBOOT=y
CONFIG_FEATURE_REBOOT_DELAY=y

CONFIG_GETTY=n
CONFIG_SETSID=y

# Debugging
CONFIG_DEBUG=n
CONFIG_FEATURE_SYSLOG=y

#
# ============================================================================
# ❌ Advanced Features (Disable for minimal profile)
# ============================================================================
#

CONFIG_FAKEIDENTD=n
CONFIG_FTPD=n
CONFIG_FTPGET=n
CONFIG_FTPPUT=n
CONFIG_HTTPD=n
CONFIG_FEATURE_HTTPD_RANGES=n
CONFIG_FEATURE_HTTPD_USE_SENDFILE=n
CONFIG_FEATURE_HTTPD_SETUID=n
CONFIG_FEATURE_HTTPD_BASIC_AUTH=n
CONFIG_FEATURE_HTTPD_CGI=n
CONFIG_FEATURE_HTTPD_CONFIG_WITH_MIME_TYPES=n
CONFIG_FEATURE_HTTPD_CONFIG_WITH_SCRIPT_INTERP=n
CONFIG_FEATURE_HTTPD_SET_REMOTE_PORT_TO_ENV=n
CONFIG_FEATURE_HTTPD_AUTH_MD5=n
CONFIG_FEATURE_HTTPD_RANGES=n
CONFIG_FEATURE_HTTPD_GZIP=n
CONFIG_FEATURE_HTTPD_ETAG=n
CONFIG_FEATURE_HTTPD_LAST_MODIFIED=n

#
# ============================================================================
# ✅ SIMPLE BUILT-INS (Keep as-is)
# ============================================================================
#

CONFIG_FEATURE_BASH_TITLE=y
CONFIG_FEATURE_CMDLINE_MODULE_OPTIONS=y
CONFIG_FEATURE_SHOW_WARNINGS=y
CONFIG_FEATURE_VERBOSE_CP_MESSAGE=y
CONFIG_FEATURE_COPYBUF_KB=4
CONFIG_FEATURE_SKIP_ROOTFS_CHECK=y
CONFIG_MONOTONIC_SYSCALL=y
CONFIG_IOCTL_HEX2STR_ERROR=y
CONFIG_FEATURE_DEVPTS=n

# ============================================================================
# END OF CONFIG
# ============================================================================
# SabaOS BusyBox Profile v1.0
# Target: Portable POSIX personality layer for Fishix kernel
# Size: ~1.5-2.5 MB static binary
# Philosophy: Kernel-agnostic, not Linux-centric
# ============================================================================
```
